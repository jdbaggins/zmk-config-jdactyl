## boards/shields/jdactyl/Kconfig.shield
```kconfig
config SHIELD_JDACTYL_LEFT
    def_bool $(shields_list_contains,jdactyl_left)

config SHIELD_JDACTYL_RIGHT
    def_bool $(shields_list_contains,jdactyl_right)
```

## config/boards/shields/jdactyl/Kconfig.defconfig
```kconfig
if SHIELD_JDACTYL_LEFT

config ZMK_KEYBOARD_NAME
    default "jdactyl"

config ZMK_SPLIT_ROLE_CENTRAL
    default y

endif

if SHIELD_JDACTYL_LEFT || SHIELD_JDACTYL_RIGHT

config ZMK_SPLIT
    default y

endif
```
