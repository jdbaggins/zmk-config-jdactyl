#include "jdactyl.dtsi" 

&kscan0 {
    col-gpios
        = <&gpio1 6 GPIO_ACTIVE HIGH>
        , <&gpio1 4 GPIO_ACTIVE HIGH>
        , <&gpio0 11 GPIO_ACTIVE HIGH>
        , <&gpio1 0 GPIO_ACTIVE HIGH>
        , <&gpio0 24 GPIO_ACTIVE HIGH>
        , <&gpio0 22 GPIO_ACTIVE HIGH>
        ;
};