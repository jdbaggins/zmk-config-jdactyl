#include <behaviors.dtsi>
#include <dt-bindings/zmk/keys.h>
#include <dt-bindings/zmk/bt.h>
#include <dt-bindings/zmk/outputs.h>
#include <dt-bindings/zmk/mouse.h>

#define DEFAULT 0
#define LOWER 1
#define RAISE 2
#define ADJUST 3

/ {
    keymap {
        compatible = "zmk,keymap";

        default_layer {
            display-name = "base"
            bindings = <
                &kp ESC           &kp NUMBER_1    &kp NUMBER_2    &kp NUMBER_3    &kp NUMBER_4    &kp NUMBER_5                      &kp NUMBER_6    &kp NUMBER_7    &kp NUMBER_8    &kp NUMBER_9    &kp NUMBER_0    &kp BACKSPACE
                &kp TAB           &kp Q           &kp W           &kp E           &kp R           &kp T                             &kp Y           &kp U           &kp I           &kp O           &kp P           &kp BACKSLASH
                &kp LEFT_SHIFT    &kp A           &kp S           &kp D           &kp F           &kp G                             &kp H           &kp J           &kp K           &kp L           &kp SEMICOLON   &kp SQT
                &kp LEFT_CONTROL  &kp Z           &kp X           &kp C           &kp V           &kp B                             &kp N           &kp M           &kp COMMA       &kp DOT         &kp SLASH       &kp MINUS
                                                  &kp LEFT_WIN    &kp LEFT_ALT                                                                                      &mo 2       &kp EQUAL
                                                                                  &mo 1           &kp SPACE                         &kp SPACE       &kp ENTER
                                                                                  &kp TAB           &kp HOME                        &kp END         &kp DELETE
                                                                                  &kp LEFT_BRACKET  &kp C_VOL_DN                    &kp C_VOL_UP    &kp RIGHT_BRACKET
            >;
        };

        layer_1 {
            display-name = "L1"
            bindings = <
                &none &none &none    &none    &none     &none          &none &none          &none          &none           &none &none 
                &none &none &none    &kp UP   &none     &none          &none &mkp MB1       &mmv MOVE_UP   &mkp MB2        &none &none 
                &none &none &kp LEFT &kp DOWN &kp RIGHT &none          &none &mmv MOVE_LEFT &mmv MOVE_DOWN &mmv MOVE_RIGHT &none &none 
                &none &none &none    &none    &none     &none          &none &msc SCRL_UP   &mkp MB3       &msc SCRL_DOWN  &none &none 
                            &none    &none                                                  &none          &none 
                                              &none     &none          &none &none 
                                              &none     &none          &none &none 
                                              &none     &none          &none &none 
            >;
        };

 //       lower_layer {
 //           bindings = <
 //               &trans &trans &trans &trans &trans                       &kp C_VOL_UP   &trans       &kp UP    &trans    &kp PG_UP
 //               &trans &kp PSCRN &trans &trans &trans                       &kp C_MUTE     &kp LEFT     &kp DOWN  &kp RIGHT &kp PG_DN
 //               &trans &trans &trans &trans &trans                       &kp C_VOL_DN   &kp FSLH     &kp BSLH  &kp QMARK &kp PIPE
 //                      &trans &trans                                                    &mkp LCLK    &mkp RCLK
 //                                    &trans &trans                       &trans &trans
 //                                           &trans &trans         &trans &trans
 //                                           &trans &trans         &trans &trans
 //           >;
 //       };
 //
 //        raise_layer {
 //            bindings = <
 //   &kp F1    &kp F2  &kp F3    &kp F4    &kp F5                        &kp F6     &kp F7    &kp F8      &kp F9    &kp F10
 //   &kp N1    &kp N2  &kp N3    &kp N4    &kp N5                        &kp N6     &kp N7    &kp N8      &kp N9    &kp N0
 //   &kp EXCL  &kp AT  &kp HASH  &kp DLLR  &kp PRCNT                     &kp CARET  &kp AMPS  &kp ASTRK   &kp LPAR  &kp RPAR
 //             &kp F11 &kp F12                                                                &trans      &trans
 //                              &trans    &trans                        &trans     &trans
 //                                         &trans    &trans    &trans    &trans
 //                                        &trans    &trans    &trans    &trans
 //           >;
 //       };
 //	adjust_layer {
 //           bindings = <
 //		&kp F1        &kp F2       &kp F3       &kp F4        &kp F5           &kp F6  &kp F7  &kp F8   &kp F9   &kp F10
 //               &out OUT_BLE  &bt BT_SEL 0 &bt BT_SEL 1 &bt BT_SEL 2  &bt BT_SEL 3     &none   &none   &none    &kp F11  &kp F12
 //               &out OUT_USB  &none        &none        &none         &none            &none   &none   &none    &none    &none 
 //                             &bt BT_CLR   &bt BT_CLR_ALL                                              &none    &none
 //                                                     &none &none                      &none &none
 //                                                     &none &none                      &none &none
 //                                                     &none &none                      &none &none
 //          >;
 //       };
    };
};